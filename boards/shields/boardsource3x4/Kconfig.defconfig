## boards/shields/boardsource3x4/Kconfig.defconfig
```kconfig
# Copyright (c) 2020 The ZMK Contributors
# SPDX-License-Identifier: MIT

if SHIELD_BOARDSOURCE3X4

config ZMK_KEYBOARD_NAME
    default "Boardsource 3x4"

config ZMK_POINTING
    default y

config CONFIG_ADC
    default y

config CONFIG_ADC_ASYNC
    default y

config CONFIG_ANALOG_INPUT
    default y

config CONFIG CONFIG_ANALOG_INPUT_LOG_DBG_RAW
    default y

config CONFIG_ANALOG_INPUT_LOG_DBG_REPORT
    default y
    
endif
```
